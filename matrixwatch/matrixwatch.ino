//graphic resources
const unsigned char BT1 [] PROGMEM = {
  0x08, 0x0c, 0x0a, 0x89, 0x4a, 0x2c, 0x18, 0x2c, 0x4a, 0x89, 0x0a, 0x0c, 0x08
};
const unsigned char BT2 [] PROGMEM = {
  0x00, 0x00, 0x00, 0x82, 0x44, 0x28, 0x10, 0x28, 0x44, 0x82, 0x00, 0x00, 0x00
};
const unsigned char BATT1 [] PROGMEM = {
  0x3c, 0xff, 0x81, 0xbd, 0xbd, 0x81, 0xbd, 0xbd, 0x81, 0xbd, 0xbd, 0x81, 0xff
};
const unsigned char BATT2 [] PROGMEM = {
  0x3c, 0xff, 0x81, 0x81, 0x81, 0x81, 0xbd, 0xbd, 0x81, 0xbd, 0xbd, 0x81, 0xff
};
const unsigned char BATT3 [] PROGMEM = {
  0x3c, 0xff, 0x81, 0x81, 0x81, 0x81, 0x81, 0x81, 0x81, 0xbd, 0xbd, 0x81, 0xff
};
const unsigned char BATT4 [] PROGMEM = {
  0x3c, 0xff, 0x81, 0x99, 0x99, 0x99, 0x99, 0x99, 0x81, 0x99, 0x99, 0x81, 0xff
};
const unsigned char NALM [] PROGMEM = {
  0xff, 0x00, 0x7e, 0x00, 0x18, 0x42, 0xdb, 0x24, 0x42, 0x42, 0x24, 0x5a, 0xc3
};
const unsigned char LINE [] PROGMEM = {
  0xff, 0xff, 0xff, 0xff, 0xff, 0xff, 0xff, 0xff, 0xff, 0xff, 0xff, 0xff, 0xff, 0xff, 0xff, 0xff
};
const unsigned char CLOCK [] PROGMEM = {
  0x0f, 0x80, 0x32, 0x60, 0x40, 0x10, 0x50, 0x10, 0x88, 0x08, 0x84, 0x08, 0xc2, 0x18, 0x82, 0x08, 
  0x82, 0x08, 0x42, 0x10, 0x40, 0x10, 0x32, 0x60, 0x0f, 0x80
};
const unsigned char ALARM [] PROGMEM = {
  0x07, 0x00, 0x05, 0x00, 0x0f, 0x80, 0x10, 0x40, 0x10, 0x40, 0x20, 0x20, 0x20, 0x20, 0x20, 0x20, 
  0x20, 0x20, 0x20, 0x20, 0x7f, 0xf0, 0x02, 0x00, 0x02, 0x00
};
const unsigned char TIMER [] PROGMEM = {
  0xff, 0xf8, 0x40, 0x10, 0x20, 0x20, 0x12, 0x40, 0x0f, 0x80, 0x07, 0x00, 0x02, 0x00, 0x05, 0x00, 
  0x08, 0x80, 0x12, 0x40, 0x27, 0x20, 0x4f, 0x90, 0xff, 0xf8
};
const unsigned char STOPW [] PROGMEM = {
  0x0f, 0x80, 0x33, 0xe0, 0x43, 0xf0, 0x43, 0xf0, 0x83, 0xf8, 0x83, 0xf8, 0xe3, 0xf8, 0x80, 0x08, 
  0x80, 0x08, 0x40, 0x10, 0x42, 0x10, 0x32, 0x60, 0x0f, 0x80
};
const unsigned char TALLY [] PROGMEM = {
  0x00, 0x00, 0x15, 0x40, 0x15, 0x40, 0x15, 0x58, 0x15, 0x60, 0x15, 0xc0, 0x17, 0x40, 0x1d, 0x40, 
  0x35, 0x40, 0xd5, 0x40, 0x15, 0x40, 0x15, 0x40, 0x00, 0x00
};
const unsigned char TEMP [] PROGMEM = {
  0x02, 0x00, 0x05, 0x00, 0x05, 0x00, 0x05, 0x00, 0x07, 0x00, 0x07, 0x00, 0x07, 0x00, 0x0a, 0x80, 
  0x17, 0x40, 0x17, 0x40, 0x17, 0x40, 0x08, 0x80, 0x07, 0x00
};
const unsigned char DICE [] PROGMEM = {
  0xff, 0xf8, 0x80, 0x08, 0xb0, 0x68, 0xb0, 0x68, 0x80, 0x08, 0x80, 0x08, 0x80, 0x08, 0x80, 0x08, 
  0x80, 0x08, 0xb0, 0x68, 0xb0, 0x68, 0x80, 0x08, 0xff, 0xf8
};
const unsigned char MOON [] PROGMEM = {
  0x0f, 0x80, 0x03, 0xc0, 0x01, 0xe0, 0x00, 0xe0, 0x00, 0x70, 0x00, 0x70, 0x00, 0x70, 0x00, 0x70, 
0x00, 0x70, 0x00, 0xe0, 0x01, 0xe0, 0x03, 0xc0, 0x0f, 0x80
};
const unsigned char HOT [] PROGMEM = {
  0x03, 0xfe, 0x00, 0x0f, 0xff, 0x80, 0x1f, 0xf9, 0xc0, 0x3f, 0xfc, 0xe0, 0x7f, 0xfe, 0x70, 0x7f, 
  0xff, 0xf0, 0xff, 0xff, 0xf8, 0xff, 0xff, 0xf8, 0xff, 0xff, 0xf8, 0xff, 0xff, 0xf8, 0xff, 0xff, 
  0xf8, 0xff, 0xff, 0xf8, 0xff, 0xff, 0xf8, 0xff, 0xff, 0xf8, 0xff, 0xff, 0xf8, 0x7f, 0xff, 0xf0, 
  0x7f, 0xff, 0xf0, 0x3f, 0xff, 0xe0, 0x1f, 0xff, 0xc0, 0x0f, 0xff, 0x80, 0x03, 0xfe, 0x00
};
const unsigned char NICE [] PROGMEM = {
  0x03, 0xfe, 0x00, 0x0c, 0x01, 0x80, 0x10, 0x00, 0x40, 0x20, 0x00, 0x20, 0x40, 0x00, 0x10, 0x43, 
  0x06, 0x10, 0x83, 0x06, 0x08, 0x83, 0x06, 0x08, 0x80, 0x00, 0x08, 0x80, 0x00, 0x08, 0x80, 0x00, 
  0x08, 0x80, 0x00, 0x08, 0x88, 0x00, 0x88, 0x88, 0x00, 0x88, 0x84, 0x01, 0x08, 0x43, 0xfe, 0x10, 
  0x40, 0x00, 0x10, 0x20, 0x00, 0x20, 0x10, 0x00, 0x40, 0x0c, 0x01, 0x80, 0x03, 0xfe, 0x00
};
const unsigned char COLD [] PROGMEM = {
  0x00, 0xa8, 0x00, 0x00, 0x50, 0x00, 0x01, 0x24, 0x00, 0x00, 0xa8, 0x00, 0xa0, 0x70, 0x28, 0x28, 
  0x20, 0xa0, 0xe8, 0x20, 0xb8, 0x18, 0x50, 0xc0, 0x78, 0x50, 0xf0, 0x05, 0x8d, 0x00, 0x02, 0x22, 
  0x00, 0x05, 0x8d, 0x00, 0x78, 0x50, 0xf0, 0x18, 0x50, 0xc0, 0xe8, 0x20, 0xb8, 0x28, 0x20, 0xa0, 
  0xa0, 0x70, 0x28, 0x00, 0xa8, 0x00, 0x01, 0x24, 0x00, 0x00, 0x50, 0x00, 0x00, 0xa8, 0x00
};
const unsigned char M1 [] PROGMEM = {
  0x02, 0xaa, 0x00, 0x08, 0x00, 0x80, 0x00, 0x00, 0x00, 0x20, 0x00, 0x20, 0x00, 0x00, 0x00, 0x40, 
  0x00, 0x10, 0x00, 0x00, 0x00, 0x80, 0x00, 0x08, 0x00, 0x00, 0x00, 0x80, 0x00, 0x08, 0x00, 0x00, 
  0x00, 0x80, 0x00, 0x08, 0x00, 0x00, 0x00, 0x80, 0x00, 0x08, 0x00, 0x00, 0x00, 0x40, 0x00, 0x10, 
  0x00, 0x00, 0x00, 0x20, 0x00, 0x20, 0x00, 0x00, 0x00, 0x08, 0x00, 0x80, 0x02, 0xaa, 0x00
};
const unsigned char M2 [] PROGMEM = {
  0x02, 0xbe, 0x00, 0x08, 0x0f, 0x80, 0x00, 0x07, 0xc0, 0x20, 0x03, 0xe0, 0x00, 0x01, 0xf0, 0x40, 
  0x00, 0xf0, 0x00, 0x00, 0xf8, 0x80, 0x00, 0x78, 0x00, 0x00, 0x78, 0x80, 0x00, 0x78, 0x00, 0x00, 
  0x78, 0x80, 0x00, 0x78, 0x00, 0x00, 0x78, 0x80, 0x00, 0x78, 0x00, 0x00, 0xf8, 0x40, 0x00, 0xf0, 
  0x00, 0x01, 0xf0, 0x20, 0x03, 0xe0, 0x00, 0x07, 0xc0, 0x08, 0x0f, 0x80, 0x02, 0xbe, 0x00
};
const unsigned char M3 [] PROGMEM = {
  0x02, 0xbe, 0x00, 0x08, 0x1f, 0x80, 0x00, 0x1f, 0xc0, 0x20, 0x1f, 0xe0, 0x00, 0x1f, 0xf0, 0x40, 
  0x1f, 0xf0, 0x00, 0x1f, 0xf8, 0x80, 0x1f, 0xf8, 0x00, 0x1f, 0xf8, 0x80, 0x1f, 0xf8, 0x00, 0x1f, 
  0xf8, 0x80, 0x1f, 0xf8, 0x00, 0x1f, 0xf8, 0x80, 0x1f, 0xf8, 0x00, 0x1f, 0xf8, 0x40, 0x1f, 0xf0, 
  0x00, 0x1f, 0xf0, 0x20, 0x1f, 0xe0, 0x00, 0x1f, 0xc0, 0x08, 0x1f, 0x80, 0x02, 0xbe, 0x00
};
const unsigned char M4 [] PROGMEM = {
  0x02, 0xbe, 0x00, 0x08, 0xff, 0x80, 0x01, 0xff, 0xc0, 0x23, 0xff, 0xe0, 0x07, 0xff, 0xf0, 0x47, 
  0xff, 0xf0, 0x0f, 0xff, 0xf8, 0x8f, 0xff, 0xf8, 0x0f, 0xff, 0xf8, 0x8f, 0xff, 0xf8, 0x0f, 0xff, 
  0xf8, 0x8f, 0xff, 0xf8, 0x0f, 0xff, 0xf8, 0x8f, 0xff, 0xf8, 0x0f, 0xff, 0xf8, 0x47, 0xff, 0xf0, 
  0x07, 0xff, 0xf0, 0x23, 0xff, 0xe0, 0x01, 0xff, 0xc0, 0x08, 0xff, 0x80, 0x02, 0xbe, 0x00
};
const unsigned char M5 [] PROGMEM = {
  0x03, 0xfe, 0x00, 0x0f, 0xff, 0x80, 0x1f, 0xff, 0xc0, 0x3f, 0xff, 0xe0, 0x7f, 0xff, 0xf0, 0x7f, 
  0xff, 0xf0, 0xff, 0xff, 0xf8, 0xff, 0xff, 0xf8, 0xff, 0xff, 0xf8, 0xff, 0xff, 0xf8, 0xff, 0xff, 
  0xf8, 0xff, 0xff, 0xf8, 0xff, 0xff, 0xf8, 0xff, 0xff, 0xf8, 0xff, 0xff, 0xf8, 0x7f, 0xff, 0xf0, 
  0x7f, 0xff, 0xf0, 0x3f, 0xff, 0xe0, 0x1f, 0xff, 0xc0, 0x0f, 0xff, 0x80, 0x03, 0xfe, 0x00
};
const unsigned char M6 [] PROGMEM = {
  0x03, 0xea, 0x00, 0x0f, 0xc0, 0x80, 0x1f, 0xc0, 0x00, 0x3f, 0xc0, 0x20, 0x7f, 0xc0, 0x00, 0x7f, 
  0xc0, 0x10, 0xff, 0xc0, 0x00, 0xff, 0xc0, 0x08, 0xff, 0xc0, 0x00, 0xff, 0xc0, 0x08, 0xff, 0xc0, 
  0x00, 0xff, 0xc0, 0x08, 0xff, 0xc0, 0x00, 0xff, 0xc0, 0x08, 0xff, 0xc0, 0x00, 0x7f, 0xc0, 0x10, 
  0x7f, 0xc0, 0x00, 0x3f, 0xc0, 0x20, 0x1f, 0xc0, 0x00, 0x0f, 0xc0, 0x80, 0x03, 0xea, 0x00
};
const unsigned char M7 [] PROGMEM = {
  0x03, 0xc0, 0x00, 0x0f, 0xc0, 0x00, 0x1f, 0xc0, 0x00, 0x3f, 0xc0, 0x00, 0x7f, 0xc0, 0x00, 0x7f, 
  0xc0, 0x00, 0xff, 0xc0, 0x00, 0xff, 0xc0, 0x00, 0xff, 0xc0, 0x00, 0xff, 0xc0, 0x00, 0xff, 0xc0, 
  0x00, 0xff, 0xc0, 0x00, 0xff, 0xc0, 0x00, 0xff, 0xc0, 0x00, 0xff, 0xc0, 0x00, 0x7f, 0xc0, 0x00, 
  0x7f, 0xc0, 0x00, 0x3f, 0xc0, 0x00, 0x1f, 0xc0, 0x00, 0x0f, 0xc0, 0x00, 0x03, 0xc0, 0x00
};
const unsigned char M8 [] PROGMEM = {
  0x03, 0xea, 0x00, 0x0f, 0x80, 0x80, 0x1f, 0x00, 0x00, 0x3e, 0x00, 0x20, 0x7c, 0x00, 0x00, 0x78, 
  0x00, 0x10, 0xf8, 0x00, 0x00, 0xf0, 0x00, 0x08, 0xf0, 0x00, 0x00, 0xf0, 0x00, 0x08, 0xf0, 0x00, 
  0x00, 0xf0, 0x00, 0x08, 0xf0, 0x00, 0x00, 0xf0, 0x00, 0x08, 0xf8, 0x00, 0x00, 0x78, 0x00, 0x10, 
  0x7c, 0x00, 0x00, 0x3e, 0x00, 0x20, 0x1f, 0x00, 0x00, 0x0f, 0x80, 0x80, 0x03, 0xea, 0x00
};
const unsigned char PROGMEM SPLASH [] = {
  0xff, 0xff, 0xff, 0xff, 0xff, 0xff, 0xff, 0xff, 0xff, 0xff, 0xff, 0xff, 0xff, 0xff, 0xff, 0xff, 
  0xff, 0xff, 0xff, 0xff, 0xff, 0xff, 0xff, 0xff, 0xff, 0xff, 0xff, 0xff, 0xff, 0xff, 0xff, 0xff, 
  0xff, 0xff, 0xff, 0xff, 0xff, 0xff, 0xff, 0xff, 0xff, 0xff, 0xff, 0xff, 0xff, 0xff, 0xff, 0xff, 
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  0xff, 0xff, 0xff, 0xff, 0xff, 0xff, 0xff, 0xff, 0xff, 0xff, 0xff, 0xff, 0xff, 0xff, 0xff, 0xff
};

#include <DS3231.h>
#include <Adafruit_GFX.h>
#include <Adafruit_MonoOLED.h>
#include <Adafruit_SPITFT.h>
#include <Adafruit_SPITFT_Macros.h>
#include <gfxfont.h>
#include <Adafruit_I2CDevice.h>
#include <Wire.h>
#include <Adafruit_SSD1306.h>
#include <SensorToButton.h>

#define OLED_ADDR   0x3C
Adafruit_SSD1306 display(-1);
#if (SSD1306_LCDHEIGHT != 64)
#error("Height incorrect, please fix Adafruit_SSD1306.h!");
#endif

DS3231  rtc(SDA, SCL);
Time t;

//Constants and variables
const float pi = 3.141592654;
const int buttonPin1 = 46;
const int buttonPin2 = 48;
const int buttonPin3 = 50;
const int buttonPin4 = 52;
const int buzzer = 53;
int buttonState1 = 0;
int buttonState2 = 0;
int buttonState3 = 0;
int buttonState4 = 0;
int mode = 0;
int alarm_min = 7;
int alarm_hour = 8;
int sides = 6;
int roll = 1;
int tally = 0;
int alarmSet = 0;
bool alarmEnable = false;
long previousMillis1 = 0;
unsigned long currentMillis1 = 0;

SensorToButton button1(buttonPin1, 10);
SensorToButton button2(buttonPin2, 50);
SensorToButton button3(buttonPin3, 50);
SensorToButton button4(buttonPin4, 50);

void setup() {
  //Initialization
  Serial.begin(9600);
  pinMode(buzzer, OUTPUT);
  rtc.begin();
  Wire.begin();  
  display.begin(SSD1306_SWITCHCAPVCC, OLED_ADDR);
  //rtc.setDate(30, 7, 2020); 
  //rtc.setDOW(WEDNESDAY); 
  
  
  //Startup sequence
  display.clearDisplay();
  display.drawBitmap(0, 0, SPLASH, 128, 64, WHITE);
  display.display(); 
  delay(2000);
  display.clearDisplay();
  display.display(); 
}

void loop() {
  buttonPress();
  currentMillis1 = millis();
  if (currentMillis1 - previousMillis1 > 1000) {
    previousMillis1 = currentMillis1;
    statusRefresh();
    display.display();
  }
}

//Status bar
void statusRefresh () {
  display.clearDisplay();
  int voltage = analogRead(A0);
  voltage = voltage * 5.0/1023;
  display.drawBitmap(116, 0, BATT4, 8, 13, WHITE);
  display.drawBitmap(104, 0, BT1, 8, 13, WHITE);
  if (alarmEnable == true){
    display.drawBitmap(92, 0, NALM, 8, 13, WHITE); 
  }
  display.drawBitmap(0, 17, LINE, 128, 1, WHITE);
  if (mode == 1){
    display.drawBitmap(0, 0, CLOCK, 13, 13, WHITE); 
    clockDigital();
  }
  else if (mode == 2) {
    display.drawBitmap(0, 0, ALARM, 13, 13, WHITE); 
    wAlarm();
  }
  else if (mode == 3) {
    display.drawBitmap(0, 0, TIMER, 13, 13, WHITE); 
  }
  else if (mode == 4) {
    display.drawBitmap(0, 0, STOPW, 13, 13, WHITE); 
  }
  else if (mode == 5) {
    display.drawBitmap(0, 0, TEMP, 13, 13, WHITE); 
    wTemp();
  }
  else if (mode == 6) {
    display.drawBitmap(0, 0, TALLY, 13, 13, WHITE); 
    wTally();
  }
  else if (mode == 7) {
    display.drawBitmap(0, 0, DICE, 13, 13, WHITE); 
    wDice();
  }
  else if (mode == 8) {
    display.drawBitmap(0, 0, MOON, 13, 13, WHITE); 
    wMoon();
  }
  else if (mode > 8) {
    mode = 1;
  }
}

//Input control
void buttonPress () {
    //button #1
    button1.read();
    button2.read();
    button3.read();
    button4.read();

    //button 1
    if(button1.wasPressed()) {
      currentMillis1 = currentMillis1 + 10000;
      if (alarmSet == 0) {
        mode = mode + 1;
      }
      else {
        alarmSet = 0;
      }
    }

    //button 2
    else if(button2.wasPressed()) {
      currentMillis1 = currentMillis1 + 10000;
      if (mode == 6) {
        tally = 0;
      }
      else if (mode == 7 && sides < 99) {
        sides = sides + 1;
      }
    }

    //button 3
    else if(button3.wasPressed()) {
      currentMillis1 = currentMillis1 + 10000;
      if (mode == 6) {
        tally = tally+1;
      }
      else if (mode == 7){
        roll = random(1, sides);
      }
    }

    //button 4
    else if(button4.wasPressed()) {
      currentMillis1 = currentMillis1 + 10000;
      if (mode == 7 && sides > 1) {
        sides = sides - 1;
      }
    }
   
}

//Widgets
void clockDigital() {
      t = rtc.getTime();
      display.setTextSize(2);
      display.setTextColor(WHITE);
      display.setCursor(16,28);
      display.print(rtc.getTimeStr());
      display.setCursor(16,48);
      display.setTextSize(1);
      display.setCursor(51,48);
      display.print(rtc.getDateStr());
      display.setCursor(16,48);
      display.print(rtc.getDOWStr());
}

void wAlarm() {
      display.setTextSize(2);
      display.setTextColor(WHITE);
      display.setCursor(36,28);
      if (alarm_hour < 10) {
        display.print(0);
        display.setCursor(48,28);
        display.print(alarm_hour);
      }
      else {
        display.print(alarm_hour);
      }
      display.setCursor(60,28);
      display.print(":");
      if (alarm_min < 10) {
        display.setCursor(72,28);
        display.print("0");
        display.setCursor(84,28);
        display.print(alarm_min);
      }
      else {
        display.setCursor(72,28);
        display.print(alarm_min);
      }
      display.setTextSize(1);
      display.setCursor(0,28);
      if (alarmSet == 1) {
        display.print("SET H");
      }
      else if (alarmSet == 2) {
        display.print("SET M");
      }
}

void wTemp() {
      display.setTextSize(2);
      display.setTextColor(WHITE);
      display.setCursor(0,28);
      display.print(round((rtc.getTemp()*9)/5+32));
      display.setCursor(28,28);
      display.print("F");
      display.setCursor(0,48);
      display.setTextSize(1);
      display.print(round(rtc.getTemp()));
      display.setCursor(15,48);
      display.print("C");
      if (round((rtc.getTemp()*9)/5+32) > 84) {
        display.drawBitmap(100, 30, HOT, 21, 21, WHITE); 
      }
      else if (round((rtc.getTemp()*9)/5+32) < 85 && round((rtc.getTemp()*9)/5+32) > 54) {
        display.drawBitmap(100, 30, NICE, 21, 21, WHITE); 
      }
      else {
        display.drawBitmap(100, 30, COLD, 21, 21, WHITE); 
      }
}

void wDice() {
      display.setTextSize(2);
      display.setTextColor(WHITE);
      display.setCursor(0,28);
      display.print("Sides:");
      display.setCursor(0,48);
      display.print("Roll:");
      display.setCursor(76,28);
      display.print(sides);
      display.setCursor(64,48);
      display.print(roll);
}

void wTally() {
      display.setTextSize(2);
      display.setTextColor(WHITE);
      display.setCursor(0,28);
      display.print("Tally:");
      display.setCursor(76,28);
      display.print(tally);
}

void wMoon() {
      display.setTextSize(1);
      display.setTextColor(WHITE);
      display.setCursor(0,28);
      float lunar = ((rtc.getUnixTime(rtc.getTime()))-1595203200)/86400;
      lunar = fmod(lunar,29.5);
      if (lunar == 0){
        display.drawBitmap(100, 30, M1, 21, 21, WHITE); 
        display.print("New moon");
      }
      else if (lunar > 0 && lunar < 7) {
        display.drawBitmap(100, 30, M2, 21, 21, WHITE); 
        display.print("Waxing Crescent");
      }
      else if (lunar == 7) {
        display.drawBitmap(100, 30, M3, 21, 21, WHITE); 
        display.print("First Quarter");
      }
      else if (lunar > 7 && lunar < 14) {
        display.drawBitmap(100, 30, M4, 21, 21, WHITE); 
        display.print("Waxing Gibbous");
      }
      else if (lunar == 14) {
        display.drawBitmap(100, 30, M5, 21, 21, WHITE); 
        display.print("Full Moon");
      }
      else if (lunar > 14 && lunar < 21) {
        display.drawBitmap(100, 30, M6, 21, 21, WHITE); 
        display.print("Waning Gibbous");
      }
      else if (lunar == 21) {
        display.drawBitmap(100, 30, M7, 21, 21, WHITE);
        display.print("Last Quarter"); 
      }
      else {
        display.drawBitmap(100, 30, M8, 21, 21, WHITE); 
        display.print("Waning Crescent");
      }
      display.setCursor(0,48);
      display.print(rtc.getDateStr());
}

void beep(){
  tone(buzzer, 1000);
  
}

//Written by Hayden "Ivan" B. - 2020
